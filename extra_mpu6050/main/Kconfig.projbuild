## extra_mpu6050/main/Kconfig.projbuild
```kconfig
menu "Extra MPU6050 - Configuracao"

    config I2C_MASTER_SDA_IO
        int "GPIO do SDA (I2C)"
        range 0 48
        default 8
        help
            Pino de dados do barramento I2C ligado ao SDA do MPU6050.

    config I2C_MASTER_SCL_IO
        int "GPIO do SCL (I2C)"
        range 0 48
        default 9
        help
            Pino de clock do barramento I2C ligado ao SCL do MPU6050.

    config I2C_MASTER_FREQ_HZ
        int "Frequencia do I2C (Hz)"
        default 100000
        help
            100 kHz = modo standard. O MPU6050 aceita ate 400 kHz.

    config INFERENCE_PERIOD_MS
        int "Periodo entre leituras/inferencias (ms)"
        range 50 5000
        default 500

endmenu
```
